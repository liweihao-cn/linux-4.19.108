
/dts-v1/;
#include "foo.dtsi"

/ {
	model = "foo board";
	compatible = "none,foo";

	memory {
		reg = <0x30000000 0x04000000>;
	};

	chosen {
		bootargs = "earlycon=foo_serial,0x50000000 console=ttyS0";
	};
};
